## df/Kconfig
```kconfig
config DIALECTFORGE
	bool "DialectForge security subsystem"
	select CRYPTO
	select CRYPTO_AES
	select CRYPTO_GCM
	select CRYPTO_SHA256
	select CRYPTO_HMAC
	default y
	help
	  Enable the DialectForge kernel subsystem providing seed-based
	  dialect negotiation, dual-mode encryption (XOR + AES-256-GCM),
	  HKDF-SHA256 hierarchical seed derivation, anomaly detection,
	  and cyclic key rotation.

	  Copyright (c) 2026 John Dean Martin - Patent Pending

	  If unsure, say Y.

config DF_DEBUG
	bool "DialectForge debug logging"
	depends on DIALECTFORGE
	default y
	help
	  Enable verbose debug logging for the DialectForge subsystem.

config DF_QUARANTINE
	bool "DialectForge quarantine zones"
	depends on DIALECTFORGE
	default y
	help
	  Enable the DialectForge quarantine system. Untrusted software
	  runs in ephemeral dialect zones that are structurally
	  incompatible with the system dialect. Like a tourist with
	  an expiring visa who can't read the street signs.

config DF_ANOMALY
	bool "DialectForge anomaly detection"
	depends on DIALECTFORGE
	default y
	help
	  Enable anomaly detection for quarantined processes.
	  Monitors syscall patterns and triggers lockdown when
	  suspicious behavior is detected.
```

## fs/dialectfs/Kconfig
```kconfig
config DIALECTFS
	tristate "DialectForge encrypted filesystem"
	depends on DIALECTFORGE
	help
	  Native VFS filesystem providing transparent DialectForge
	  encryption with sector hopping. Stacks over any existing
	  filesystem. Pull the drive = noise.

	  Can be built as module (M) or compiled into kernel (Y).
	  If unsure, say Y.
```

## kernel/net/df_proto/Kconfig
```kconfig
config DF_PROTO
	tristate "DialectForge protocol family (AF_DIALECTFORGE)"
	depends on DIALECTFORGE && NET
	default y
	help
	  Register AF_DIALECTFORGE as a native protocol family.
	  Processes can create DF sockets directly:
	    socket(AF_DIALECTFORGE, SOCK_STREAM, 0)
	  All communication is automatically dialect-encrypted.

	  Copyright (c) 2026 John Dean Martin - Patent Pending
```
